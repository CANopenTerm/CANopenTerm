## yocto/meta-canopenterm/conf/layer.conf
```bitbake
# We have a conf and classes directory, add to BBPATH
BBPATH .= ":${LAYERDIR}"

# We have recipes-* directories, add to BBFILES
BBFILES += "${LAYERDIR}/recipes-*/*/*.bb \
            ${LAYERDIR}/recipes-*/*/*.bbappend"

BBFILE_COLLECTIONS += "meta-canopenterm"
BBFILE_PATTERN_meta-canopenterm = "^${LAYERDIR}/"
BBFILE_PRIORITY_meta-canopenterm = "6"

LAYERDEPENDS_meta-canopenterm = "core"
LAYERSERIES_COMPAT_meta-canopenterm = "kirkstone"

PREFERRED_VERSION_libsdl = "2.0.22"
RDEPENDS:canopenterm = "libsdl2 lua"
```
